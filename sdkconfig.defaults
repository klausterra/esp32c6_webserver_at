## sdkconfig.defaults
```kconfig
# Configurações padrão para ESP32-C6 Web Server AT

# Configurações de Wi-Fi
CONFIG_ESP32_WIFI_ENABLED=y
CONFIG_ESP32_WIFI_STATIC_RX_BUFFER_NUM=10
CONFIG_ESP32_WIFI_DYNAMIC_RX_BUFFER_NUM=32
CONFIG_ESP32_WIFI_DYNAMIC_TX_BUFFER_NUM=32
CONFIG_ESP32_WIFI_AMPDU_TX_ENABLED=y
CONFIG_ESP32_WIFI_AMPDU_RX_ENABLED=y

# Configurações de HTTP Server
CONFIG_HTTPD_MAX_REQ_HDR_LEN=1024
CONFIG_HTTPD_MAX_URI_LEN=512
CONFIG_HTTPD_ERR_RESP_NO_DELAY=y
CONFIG_HTTPD_PURGE_BUF_LEN=32

# Configurações de OTA
CONFIG_OTA_ALLOW_HTTP=y
CONFIG_OTA_ALLOW_HTTPS=y
CONFIG_OTA_ALLOW_HTTP_ETAG=y

# Configurações de NVS
CONFIG_NVS_ENCRYPTION=n
CONFIG_NVS_COMPRESSION=n
CONFIG_NVS_SEC_PROVIDER=n
CONFIG_NVS_SEC_KEY_PROTECT_NONE=y
CONFIG_NVS_SEC_KEY_PROTECT_USING_HMAC=n
CONFIG_NVS_SEC_HMAC_EFUSE_KEY_ID=0

# Configurações de Log
CONFIG_LOG_DEFAULT_LEVEL_INFO=y
CONFIG_LOG_MAXIMUM_LEVEL_VERBOSE=y

# Configurações de FreeRTOS
CONFIG_FREERTOS_HZ=1000
CONFIG_FREERTOS_TIMER_TASK_PRIORITY=1
CONFIG_FREERTOS_TIMER_TASK_STACK_DEPTH=3584

# Configurações de Memória
CONFIG_SPIRAM_SUPPORT=y
CONFIG_SPIRAM_USE_MALLOC=y
CONFIG_SPIRAM_MALLOC_ALWAYSINTERNAL=16384

# Configurações de Partição
CONFIG_PARTITION_TABLE_CUSTOM=y
CONFIG_PARTITION_TABLE_CUSTOM_FILENAME="partitions.csv"

# Configurações de Flash
CONFIG_ESPTOOLPY_FLASHSIZE_4MB=y

# Configurações de Segurança
CONFIG_SECURE_BOOT_V2_ENABLED=n
CONFIG_SECURE_FLASH_ENC_ENABLED=n

# Configurações de Debug
CONFIG_ESP32_DEBUG_OCDAWARE=y
CONFIG_ESP32_DEBUG_STUBS_ENABLE=y
```
